## config/boards/arm/mouse/Kconfig.board
```kconfig
# Copyright (c) 2020 The ZMK Contributors
# SPDX-License-Identifier: MIT

config BOARD_NEZUMI
	bool "Nezumi"
	depends on SOC_NRF52840_QIAA
```

## config/boards/arm/mouse/Kconfig.defconfig
```kconfig
# Copyright (c) 2020 The ZMK Contributors
# SPDX-License-Identifier: MIT

if BOARD_NEZUMI

config ZMK_KEYBOARD_NAME
    default "Nezumi"

config BOARD
	default "nezumi"

if USB

config USB_NRFX
	default y

config USB_DEVICE_STACK
	default y

endif # USB

config BT_CTLR
	default BT

config ZMK_BLE
	default y

config ZMK_USB
	default y

config ZMK_BATTERY_NRF_VDDH
    default y

config MAX17055
    bool "MAX17055 Fuel Gauge"
    depends on I2C && SENSOR
    help
      Enable I2C-based driver for MAX17055 Fuel Gauge. This driver supports
      reading various sensor settings including charge level percentage,
      time to full/empty, design voltage, temperature and remaining
      capacity in mA.

endif # BOARD_NEZUMI
```

## config/boards/arm/praxis/Kconfig.board
```kconfig
# Copyright (c) 2020 The ZMK Contributors
# SPDX-License-Identifier: MIT

config BOARD_PRAXIS
	bool "praxis"
	depends on SOC_NRF52840_QIAA
```

## config/boards/arm/praxis/Kconfig.defconfig
```kconfig
# Copyright (c) 2020 The ZMK Contributors
# SPDX-License-Identifier: MIT

if BOARD_PRAXIS

config ZMK_KEYBOARD_NAME
    default "Praxis"

config BOARD
	default "praxis"

if USB

config USB_NRFX
	default y

config USB_DEVICE_STACK
	default y

endif # USB

config BT_CTLR
	default BT

config ZMK_BLE
	default y

config ZMK_USB
	default y

config ZMK_BATTERY_VOLTAGE_DIVIDER
	default y

config MAX17055
    bool "MAX17055 Fuel Gauge"
    depends on I2C && SENSOR
    help
      Enable I2C-based driver for MAX17055 Fuel Gauge. This driver supports
      reading various sensor settings including charge level percentage,
      time to full/empty, design voltage, temperature and remaining
      capacity in mA.

endif # BOARD_PRAXIS
```

## config/west.yml
```yaml
manifest:
  remotes:
    - name: zmkfirmware
      url-base: https://github.com/zmkfirmware
    - name: EricDracula
      url-base: https://github.com/EricDracula
  projects:
    - name: zmk
      remote: EricDracula
      revision: dracula-test
      import: app/west.yml
  self:
    path: zmk-config
```
